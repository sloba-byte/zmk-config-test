## config/Kconfig.defconfig
```kconfig
# Copyright (c) 2020 The ZMK Contributors
# SPDX-License-Identifier: MIT

config ZMK_KEYBOARD_NAME
    default "dare_reviung41"
```

## config/boards/shields/my_reviung41/Kconfig.defconfig
```kconfig
# Copyright (c) 2020 The ZMK Contributors
# SPDX-License-Identifier: MIT

if SHIELD_MY_REVIUNG41

config ZMK_KEYBOARD_NAME
    default "my_reviung41"

endif
```

## config/boards/shields/my_reviung41/Kconfig.shield
```kconfig
# Copyright (c) 2020 The ZMK Contributors
# SPDX-License-Identifier: MIT

config SHIELD_MY_REVIUNG41
    def_bool $(shields_list_contains,my_reviung41)
```
